## conf/layer.conf
```bitbake
# We have a conf and classes directory, add to BBPATH
BBPATH .= ":${LAYERDIR}"

# We have recipes-* directories, add to BBFILES
BBFILES += "${LAYERDIR}/recipes-*/*/*.bb \
	${LAYERDIR}/recipes-*/*/*.bbappend"

BBFILE_COLLECTIONS += "jay"
BBFILE_PATTERN_jay = "^${LAYERDIR}/"
BBFILE_PRIORITY_jay = "6"
```

## conf/machine/imx6ul-breakout.conf
```bitbake
#@TYPE: Machine
#@NAME: i.MX6UL-Breakout
#@SOC: i.MX6S
#@DESCRIPTION: Machine configuration for i.MX6UL-Breakout
#@MAINTAINER: Jay Carlson <jay.d.carlson@gmail.com>

MACHINEOVERRIDES =. "mx6:mx6ul:"

include conf/machine/include/imx-base.inc
include conf/machine/include/tune-cortexa7.inc

MACHINE_FEATURES += " pci wifi bluetooth"

KERNEL_DEVICETREE = "imx6ul-14x14-evk.dtb imx6ul-14x14-evk-csi.dtb imx6ul-14x14-evk-btwifi.dtb \
                     imx6ul-14x14-evk-gpmi-weim.dtb imx6ul-14x14-evk-usb-certi.dtb \
                     imx6ul-14x14-evk-emmc.dtb "

UBOOT_SUFFIX = "img"
SPL_BINARY = "SPL"
UBOOT_MAKE_TARGET = "mx6ul_breakout_config"
UBOOT_CONFIG ??= "sd"
UBOOT_CONFIG[sd] = "mx6ul_breakout_config,sdcard"

SERIAL_CONSOLE = "115200 ttymxc0"
```
